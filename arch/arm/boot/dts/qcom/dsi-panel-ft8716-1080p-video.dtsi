/*
 * G0245D FT8716 1080p video-mode DSI panel.
 *
 * Panel parameters were taken from the G0245D factory 3.18 DTB and
 * transcribed into source form. Property names follow the 4.4 msm8996
 * MDSS binding: factory "qcom,mdss-dsi-panel-timings-8996" is published
 * as "qcom,mdss-dsi-panel-timings-phy-v2" (byte content unchanged).
 * ESD/status properties are omitted on purpose: the 4.4 driver skips
 * the check entirely when qcom,esd-check-enabled is absent.
 */

&mdss_mdp {
	dsi_ft8716_1080p_video: qcom,mdss_dsi_ft8716_1080p_video {
		qcom,mdss-dsi-panel-name = "ft8716 1080p video mode dsi panel";
		qcom,mdss-dsi-panel-type = "dsi_video_mode";
		qcom,mdss-dsi-panel-destination = "display_1";
		qcom,mdss-dsi-panel-framerate = <0x3c>;
		qcom,mdss-dsi-virtual-channel-id = <0x00>;
		qcom,mdss-dsi-stream = <0x00>;
		qcom,mdss-dsi-panel-width = <0x438>;
		qcom,mdss-dsi-panel-height = <0x780>;
		qcom,mdss-dsi-h-front-porch = <0x20>;
		qcom,mdss-dsi-h-back-porch = <0x20>;
		qcom,mdss-dsi-h-pulse-width = <0x04>;
		qcom,mdss-dsi-h-sync-skew = <0x00>;
		qcom,mdss-dsi-v-back-porch = <0x10>;
		qcom,mdss-dsi-v-front-porch = <0x10>;
		qcom,mdss-dsi-v-pulse-width = <0x02>;
		qcom,mdss-dsi-h-left-border = <0x00>;
		qcom,mdss-dsi-h-right-border = <0x00>;
		qcom,mdss-dsi-v-top-border = <0x00>;
		qcom,mdss-dsi-v-bottom-border = <0x00>;
		qcom,mdss-dsi-bpp = <0x18>;
		qcom,mdss-dsi-color-order = "rgb_swap_rgb";
		qcom,mdss-dsi-underflow-color = <0xff>;
		qcom,mdss-dsi-border-color = <0x00>;
		qcom,mdss-dsi-tx-eot-append;
		qcom,mdss-dsi-on-command = [05 01 00 00 78 00 02 11 00 15 01 00 00 01 00 02
			53 2c 05 01 00 00 05 00 02 29 00 15 01 00 00 01
			00 02 55 01 15 01 00 00 00 00 02 00 00 39 01 00
			00 00 00 04 ff 87 16 01 15 01 00 00 00 00 02 00
			80 39 01 00 00 00 00 03 ff 87 16 15 01 00 00 00
			00 02 00 b0 15 01 00 00 00 00 02 ca 03 15 01 00
			00 00 00 02 00 b2 15 01 00 00 00 00 02 ca 04 15
			01 00 00 00 00 02 00 b5 15 01 00 00 00 00 02 ca
			03 15 01 00 00 00 00 02 00 00 39 01 00 00 00 00
			04 ff 00 00 00 15 01 00 00 00 00 02 00 80 39 01
			00 00 00 00 03 ff 00 00];
		qcom,mdss-dsi-off-command = [05 01 00 00 10 00 02 28 00 05 01 00 00 50 00 02 10 00];
		qcom,mdss-dsi-on-command-state = "dsi_lp_mode";
		qcom,mdss-dsi-off-command-state = "dsi_hs_mode";
		qcom,mdss-dsi-h-sync-pulse = <0x01>;
		qcom,mdss-dsi-traffic-mode = "burst_mode";
		qcom,mdss-dsi-lane-map = "lane_map_0123";
		qcom,mdss-dsi-bllp-eof-power-mode;
		qcom,mdss-dsi-bllp-power-mode;
		qcom,mdss-dsi-lane-0-state;
		qcom,mdss-dsi-lane-1-state;
		qcom,mdss-dsi-lane-2-state;
		qcom,mdss-dsi-lane-3-state;
		qcom,mdss-dsi-panel-timings = [d6 32 22 00 60 66 26 36 28 03 04 00];
		qcom,mdss-dsi-panel-timings-phy-v2 = [23 1f 07 09 05 03 04 a0 23 1f 07 09 05 03 04 a0
			23 1f 07 09 05 03 04 a0 23 1f 07 09 05 03 04 a0
			23 19 08 09 05 03 04 a0];
		qcom,mdss-dsi-t-clk-post = <0x13>;
		qcom,mdss-dsi-t-clk-pre = <0x2e>;
		qcom,mdss-dsi-bl-min-level = <0x01>;
		qcom,mdss-dsi-bl-max-level = <0x3b9>;
		qcom,mdss-dsi-bl-pmic-control-type = "bl_ctrl_dcs";
		qcom,mdss-dsi-dma-trigger = "trigger_sw";
		qcom,mdss-dsi-mdp-trigger = "none";
		qcom,mdss-dsi-reset-sequence = <1 10>, <0 10>, <1 10>;
		qcom,mdss-dsi-lp11-init;
		qcom,panel-supply-entries = <&dsi_panel_pwr_supply>;
		qcom,platform-reset-gpio = <&tlmm 8 0>;
		qcom,platform-bklight-en-gpio = <&pm8994_gpios 14 0>;
	};
};
